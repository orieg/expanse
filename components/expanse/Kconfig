## components/expanse/Kconfig
```kconfig
menu "Expanse Embedded Digital Trie"

    config EXPANSE_SRAM_INTERNAL_ONLY
        bool "Force Expanse allocations into internal fast DRAM (MALLOC_CAP_INTERNAL)"
        default y
        help
            When enabled, libexpanse's allocator draws from internal high-speed
            DRAM (MALLOC_CAP_INTERNAL) rather than external SPI PSRAM, avoiding
            bus arbitration latency on the trie's pointer-chasing descent.
            When disabled, allocations use MALLOC_CAP_DEFAULT. Read by
            expanse_host_malloc() in src/expanse_esp_idf.c.

endmenu
```
